## csi-prototype/firmware/rx/main/Kconfig.projbuild
```kconfig
menu "CSI receiver"
    config CSI_CHANNEL
        int "Wi-Fi channel"
        range 1 11
        default 11
endmenu
```

## csi-prototype/firmware/rx/sdkconfig.defaults
```kconfig
CONFIG_IDF_TARGET="esp32s3"
CONFIG_ESPTOOLPY_FLASHSIZE_16MB=y
CONFIG_SPIRAM=y
CONFIG_SPIRAM_MODE_OCT=y
CONFIG_SPIRAM_SPEED_80M=y
CONFIG_ESP_WIFI_CSI_ENABLED=y
CONFIG_ESP_WIFI_DYNAMIC_RX_BUFFER_NUM=128
CONFIG_ESP_WIFI_AMPDU_TX_ENABLED=n
CONFIG_ESP_WIFI_AMPDU_RX_ENABLED=n
CONFIG_ESP_CONSOLE_NONE=y
```

## csi-prototype/firmware/tx/main/Kconfig.projbuild
```kconfig
menu "CSI transmitter"
    config CSI_CHANNEL
        int "Wi-Fi channel"
        range 1 11
        default 11
    config CSI_TX_RATE_HZ
        int "Probe rate Hz"
        range 1 100
        default 100
endmenu
```

## firmware/rx/main/Kconfig.projbuild
```kconfig
menu "CSI receiver"
    config CSI_CHANNEL
        int "Wi-Fi channel (must match transmitter)"
        range 1 11
        default 11
    config CSI_EXPECTED_TX_MAC
        string "Exact transmitter MAC (empty accepts either known board)"
        default ""
endmenu
```

## firmware/tx/main/Kconfig.projbuild
```kconfig
menu "CSI transmitter"
    config CSI_CHANNEL
        int "Wi-Fi channel (must match receiver)"
        range 1 11
        default 11
    config CSI_TX_RATE_HZ
        int "CSI probe rate (Hz)"
        range 1 1000
        default 100
endmenu
```
